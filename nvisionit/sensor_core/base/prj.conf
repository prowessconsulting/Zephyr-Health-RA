## prj.conf
```kconfig
CONFIG_PRINTK=y
CONFIG_STDOUT_CONSOLE=y

CONFIG_SPI=y

CONFIG_ADC=y
CONFIG_ADC_QMSI_SS=y
CONFIG_ADC_QMSI_POLL=y

CONFIG_SYS_CLOCK_TICKS_PER_SEC=1000

CONFIG_IPM=y
CONFIG_IPM_QUARK_SE=y
CONFIG_IPM_CONSOLE_SENDER=y
CONFIG_CONSOLE=y
CONFIG_SERIAL=n
CONFIG_NANO_TIMEOUTS=y

CONFIG_I2C=y
I2C_QMSI_SS=y
I2C_0=y

CONFIG_GPIO=y
CONFIG_SENSOR=y
CONFIG_BMI160=y
CONFIG_BMI160_NAME="bmi160"
CONFIG_BMI160_SPI_PORT_NAME="SPI_1"
CONFIG_BMI160_SLAVE=1
CONFIG_BMI160_SPI_BUS_FREQ=88
```

## src/main.c
```c
/* main_arc.c - main source file for ARC app */

/*
 * Copyright (c) 2016 Intel Corporation.
 *
 * Licensed under the Apache License, Version 2.0 (the "License");
 * you may not use this file except in compliance with the License.
 * You may obtain a copy of the License at
 *
 *     http://www.apache.org/licenses/LICENSE-2.0
 *
 * Unless required by applicable law or agreed to in writing, software
 * distributed under the License is distributed on an "AS IS" BASIS,
 * WITHOUT WARRANTIES OR CONDITIONS OF ANY KIND, either express or implied.
 * See the License for the specific language governing permissions and
 * limitations under the License.
 */

#include <zephyr.h>
#include <stdio.h>
#include <device.h>
#include <sensor.h>
#include <max30100_pulse_oximeter.h>

#include <ipm.h>
#include <ipm/ipm_quark_se.h>

#include <init.h>
#include <string.h>

#include <misc/byteorder.h>
#include <misc/printk.h>
#include <misc/util.h>

#include <ipm_ids.h>
#include <bmi160.h>
#include <heartrate.h>

#define INTERVAL_HRS 500

QUARK_SE_IPM_DEFINE(health_sensor_ipm, 0, QUARK_SE_IPM_OUTBOUND);

struct device *i2c_dev;
struct device *health_ipm;

struct sensor_value sensor_value_ast[3];

struct health_data
{
	uint8_t heartrate;
	uint8_t spo2;
	int16_t temperature;
	int16_t gyro_x;
	int16_t gyro_y;
	int16_t gyro_z;
	int16_t accel_x;
	int16_t accel_y;
	int16_t accel_z;
};

static double sensor_value_normalize(struct sensor_value* val)
{
	double value;

	switch (val->type) {
	case SENSOR_VALUE_TYPE_INT:
	    value = (double)(val->val1);
	    break;
	case SENSOR_VALUE_TYPE_INT_PLUS_MICRO:
		value = (double)(val->val1);
		value += ((double)(val->val2)) * 0.000001;
	    break;
	case SENSOR_VALUE_TYPE_DOUBLE:
	    value = val->dval;
	    break;
	default:
		value = 0;
	    break;
	}
	return value;
}

void main(void)
{
    int ret;

    // Get the devices
    i2c_dev = device_get_binding("I2C_0");
    if (!i2c_dev)
    {
	printk("Error getting I2C device.\n");
    }

    /* Initialize the IPM */
    health_ipm = device_get_binding("health_sensor_ipm");
    if (!health_ipm)
    {
		printk("IPM: Device not found.\n");
    }

    bmi160_sensor_init();
	
	printk("Initializing the MAX30100\n");
	printk("Initializing the MAX30100 Pulse Oximeter\n");
	max30100_init(i2c_dev);
	max30100_pulse_oximeter_init(i2c_dev);
   
	printk("Polling the MAX30100\n");

	struct health_data data;
	int16_t axis_x = 0; 
	int16_t axis_y = 0;
	int16_t axis_z = 0;

    uint64_t lastSampleTime = 0;
	while(1){
	    time = k_uptime_get();
	    max30100_pulse_oximeter_update(i2c_dev);

		if((time - lastSampleTime) > 500)
		{	
			data.heartrate = max30100_pulse_oximeter_heartrate;
			data.spo2 = max30100_pulse_oximeter_spo2;
			data.temperature = max30100_pulse_oximeter_temperature;
			
			get_accel_data(sensor_value_ast);	

			axis_x = (int16_t)(sensor_value_normalize(&sensor_value_ast[0]) * 1000.0);
			axis_y = (int16_t)(sensor_value_normalize(&sensor_value_ast[1]) * 1000.0);
			axis_z = (int16_t)(sensor_value_normalize(&sensor_value_ast[2]) * 1000.0);

			// printk("Accel: %d %d %d\n", axis_x, axis_y, axis_z);

			data.accel_x = (axis_x + data.accel_x) / 2;
			data.accel_y = (axis_y + data.accel_y) / 2;
			data.accel_z = (axis_z + data.accel_z) / 2;

			get_gyro_data(sensor_value_ast);		

			axis_x = (int16_t)(sensor_value_normalize(&sensor_value_ast[0]) * 1000.0);
			axis_y = (int16_t)(sensor_value_normalize(&sensor_value_ast[1]) * 1000.0);
			axis_z = (int16_t)(sensor_value_normalize(&sensor_value_ast[2]) * 1000.0);

			// printk("Gyro : %d %d %d\n", axis_x, axis_y, axis_z);

			data.gyro_x = (axis_x + data.gyro_x) / 2;
			data.gyro_y = (axis_y + data.gyro_y) / 2;
			data.gyro_z = (axis_z + data.gyro_z) / 2;

		    lastSampleTime = k_uptime_get();
            sample_update();

			ret = ipm_send(health_ipm, 1, IPM_ID_BMI_ALL, &data, sizeof(data));
			if (ret)
			{
				printk("Failed to send Health message, error (%d)\n", ret);
			}		

		}
	}	
}
```

## include/bmi160.h
```c
#ifndef BMI160_H
#define BMI160_H

/*
 * Copyright (c) 2016 Intel Corporation
 *
 * Licensed under the Apache License, Version 2.0 (the "License");
 * you may not use this file except in compliance with the License.
 * You may obtain a copy of the License at
 *
 *     http://www.apache.org/licenses/LICENSE-2.0
 *
 * Unless required by applicable law or agreed to in writing, software
 * distributed under the License is distributed on an "AS IS" BASIS,
 * WITHOUT WARRANTIES OR CONDITIONS OF ANY KIND, either express or implied.
 * See the License for the specific language governing permissions and
 * limitations under the License.
 */

#include <zephyr.h>
#include <stdio.h>
#include <device.h>
#include <sensor.h>
#include <misc/util.h>

#define MAX_TEST_TIME	15000
#define SLEEPTIME	300


void bmi160_sensor_init();
int sample_update();
void get_gyro_data(struct sensor_value* sensor_data_ps);
void get_accel_data(struct sensor_value* sensor_data_ps);
void get_temp_data(struct sensor_value* sensor_data_ps);

#endif
```

## include/max30100.h
```c
/*
Arduino-MAX30100 oximetry / heart rate integrated sensor library
Copyright (C) 2016  OXullo Intersecans <x@brainrapers.org>

This program is free software: you can redistribute it and/or modify
it under the terms of the GNU General Public License as published by
the Free Software Foundation, either version 3 of the License, or
(at your option) any later version.

This program is distributed in the hope that it will be useful,
but WITHOUT ANY WARRANTY; without even the implied warranty of
MERCHANTABILITY or FITNESS FOR A PARTICULAR PURPOSE.  See the
GNU General Public License for more details.

You should have received a copy of the GNU General Public License
along with this program.  If not, see <http://www.gnu.org/licenses/>.
*/

#ifndef MAX30100_H
#define MAX30100_H

#include <zephyr.h>
#include <i2c.h>
#include <stdbool.h>

////////////////////////////////
// Public functions
////////////////////////////////

int max30100_init(struct device *i2c_dev);
void max30100_set_mode(struct device *i2c_dev, uint8_t modeConfig);
void max30100_start_temperature(struct device *i2c_dev);
bool max30100_is_temperature_ready(struct device *i2c_dev);
float max30100_get_temperature(struct device *i2c_dev);
void max30100_set_leds_pulse_width(struct device *i2c_dev, uint8_t ledPulseWidth);
void max30100_set_sampling_rate(struct device *i2c_dev, uint8_t samplingRate);
void max30100_set_leds_current(struct device *i2c_dev, uint8_t irLedCurrent, uint8_t redLedCurrent);
void max30100_set_highres_mode_enabled(struct device *i2c_dev, bool enabled);
void max30100_update(struct device *i2c_dev, uint8_t* buffer);

////////////////////////////////
// I2C registers
////////////////////////////////

#define MAX30100_I2C_ADDRESS                    0x57

// Interrupt status register (RO)
#define MAX30100_REG_INTERRUPT_STATUS           0x00
#define MAX30100_IS_PWR_RDY                     (1 << 0)
#define MAX30100_IS_SPO2_RDY                    (1 << 4)
#define MAX30100_IS_HR_RDY                      (1 << 5)
#define MAX30100_IS_TEMP_RDY                    (1 << 6)
#define MAX30100_IS_A_FULL                      (1 << 7)

// Interrupt enable register
#define MAX30100_REG_INTERRUPT_ENABLE           0x01
#define MAX30100_IE_ENB_SPO2_RDY                (1 << 4)
#define MAX30100_IE_ENB_HR_RDY                  (1 << 5)
#define MAX30100_IE_ENB_TEMP_RDY                (1 << 6)
#define MAX30100_IE_ENB_A_FULL                  (1 << 7)

// FIFO control and data registers
#define MAX30100_REG_FIFO_WRITE_POINTER         0x02
#define MAX30100_REG_FIFO_OVERFLOW_COUNTER      0x03
#define MAX30100_REG_FIFO_READ_POINTER          0x04
#define MAX30100_REG_FIFO_DATA                  0x05  // Burst read does not autoincrement addr

// Mode Configuration register
#define MAX30100_REG_MODE_CONFIGURATION         0x06
#define MAX30100_MC_TEMP_EN                     (1 << 3)
#define MAX30100_MC_RESET                       (1 << 6)
#define MAX30100_MC_SHDN                        (1 << 7)
enum Mode {
    MAX30100_MODE_HRONLY    = 0x02,
    MAX30100_MODE_SPO2_HR   = 0x03
};

// SpO2 Configuration register
// Check tables 8 and 9, p19 of the MAX30100 datasheet to see the permissible
// combinations of sampling rates and pulse widths
#define MAX30100_REG_SPO2_CONFIGURATION         0x07
#define MAX30100_SPC_SPO2_HI_RES_EN             (1 << 6)
enum SamplingRate {
    MAX30100_SAMPRATE_50HZ      = 0x00,
	MAX30100_SAMPRATE_100HZ     = 0x01,
	MAX30100_SAMPRATE_167HZ     = 0x02,
	MAX30100_SAMPRATE_200HZ     = 0x03,
	MAX30100_SAMPRATE_400HZ     = 0x04,
	MAX30100_SAMPRATE_600HZ     = 0x05,
	MAX30100_SAMPRATE_800HZ     = 0x06,
	MAX30100_SAMPRATE_1000HZ    = 0x07
};

enum LEDPulseWidth {
    MAX30100_SPC_PW_200US_13BITS    = 0x00,
    MAX30100_SPC_PW_400US_14BITS    = 0x01,
    MAX30100_SPC_PW_800US_15BITS    = 0x02,
    MAX30100_SPC_PW_1600US_16BITS   = 0x03
};

// LED Configuration register
#define MAX30100_REG_LED_CONFIGURATION          0x09
enum LEDCurrent {
	MAX30100_LED_CURR_0MA      = 0x00,
	MAX30100_LED_CURR_4_4MA    = 0x01,
	MAX30100_LED_CURR_7_6MA    = 0x02,
	MAX30100_LED_CURR_11MA     = 0x03,
	MAX30100_LED_CURR_14_2MA   = 0x04,
	MAX30100_LED_CURR_17_4MA   = 0x05,
	MAX30100_LED_CURR_20_8MA   = 0x06,
	MAX30100_LED_CURR_24MA     = 0x07,
	MAX30100_LED_CURR_27_1MA   = 0x08,
	MAX30100_LED_CURR_30_6MA   = 0x09,
	MAX30100_LED_CURR_33_8MA   = 0x0a,
	MAX30100_LED_CURR_37MA     = 0x0b,
	MAX30100_LED_CURR_40_2MA   = 0x0c,
	MAX30100_LED_CURR_43_6MA   = 0x0d,
	MAX30100_LED_CURR_46_8MA   = 0x0e,
	MAX30100_LED_CURR_50MA     = 0x0f
};

// Temperature integer part register
#define MAX30100_REG_TEMPERATURE_DATA_INT       0x16
// Temperature fractional part register
#define MAX30100_REG_TEMPERATURE_DATA_FRAC      0x17

// Revision ID register (RO)
#define MAX30100_REG_REVISION_ID                0xfe
// Part ID register
#define MAX30100_REG_PART_ID                    0xff

////////////////////////////////
// Defaults
////////////////////////////////

#define DEFAULT_MODE                MAX30100_MODE_HRONLY
#define DEFAULT_SAMPLING_RATE       MAX30100_SAMPRATE_100HZ
#define DEFAULT_PULSE_WIDTH         MAX30100_SPC_PW_1600US_16BITS
#define DEFAULT_RED_LED_CURRENT     MAX30100_LED_CURR_50MA
#define DEFAULT_IR_LED_CURRENT      MAX30100_LED_CURR_50MA

////////////////////////////////
// SpO2 Calculation section
////////////////////////////////

#define CALCULATE_EVERY_N_BEATS         3

////////////////////////////////
// PulseOximeter section
////////////////////////////////


enum PulseOximeterDebuggingMode {
    PULSEOXIMETER_DEBUGGINGMODE_NONE,
    PULSEOXIMETER_DEBUGGINGMODE_RAW_VALUES,
    PULSEOXIMETER_DEBUGGINGMODE_AC_VALUES,
    PULSEOXIMETER_DEBUGGINGMODE_PULSEDETECT
} ;

uint64_t time;

#endif
```

## include/max30100_beat_detector.h
```c
#include <max30100.h>

#define BEATDETECTOR_INIT_HOLDOFF                4000    // in ms, how long to wait before counting
#define BEATDETECTOR_MASKING_HOLDOFF             200     // in ms, non-retriggerable window after beat detection
#define BEATDETECTOR_BPFILTER_ALPHA              0.8     // EMA factor for the beat period value
#define BEATDETECTOR_MIN_THRESHOLD               20      // minimum threshold (filtered) value
#define BEATDETECTOR_MAX_THRESHOLD               800     // maximum threshold (filtered) value
#define BEATDETECTOR_STEP_RESILIENCY             30      // maximum negative jump that triggers the beat edge
#define BEATDETECTOR_THRESHOLD_FALLOFF_TARGET    0.3     // thr chasing factor of the max value when beat
#define BEATDETECTOR_THRESHOLD_DECAY_FACTOR      0.99    // thr chasing factor when no beat
#define BEATDETECTOR_INVALID_READOUT_DELAY       2000    // in ms, no-beat time to cause a reset
#define BEATDETECTOR_SAMPLES_PERIOD              10      // in ms, 1/Fs

typedef enum BeatDetectorState {
    BEATDETECTOR_STATE_INIT,
    BEATDETECTOR_STATE_WAITING,
    BEATDETECTOR_STATE_FOLLOWING_SLOPE,
    BEATDETECTOR_STATE_MAYBE_DETECTED,
    BEATDETECTOR_STATE_MASKING
} BeatDetectorState;

bool max30100_beat_detector_sample(float ir_sample_f32);
float max30100_beat_detector_get_rate();
void max30100_beat_detector_reset();
```

## include/max30100_pulse_oximeter.h
```c
#include <max30100.h>
#include <max30100_beat_detector.h>
#include <max30100_spo2_calculator.h>

#define SAMPLING_FREQUENCY                  100
#define SAMPLE_TIME                         (1000 / SAMPLING_FREQUENCY)
#define CURRENT_ADJUSTMENT_PERIOD_MS        500
#define IR_LED_CURRENT                      MAX30100_LED_CURR_50MA
#define RED_LED_CURRENT_START               MAX30100_LED_CURR_27_1MA
#define DC_REMOVER_ALPHA                    0.95
#define TEMPERATURE_SAMPLING_PERIOD_MS      10000

typedef enum PulseOximeterState {
    PULSEOXIMETER_STATE_INIT,
    PULSEOXIMETER_STATE_IDLE,
    PULSEOXIMETER_STATE_DETECTING
} PulseOximeterState;

void max30100_pulse_oximeter_init(struct device *i2c_dev);
void max30100_pulse_oximeter_update(struct device *i2c_dev);

uint8_t max30100_pulse_oximeter_heartrate;
uint8_t max30100_pulse_oximeter_spo2;
int16_t max30100_pulse_oximeter_temperature;
```

## include/max30100_spo2_calculator.h
```c
#include <max30100.h>

void max30100_spo2_calculator_update(float led_ir_ac_value, float led_red_ac_value, bool beat_detected);
void max30100_spo2_calculator_reset();
uint8_t max30100_spo2_calculator_get_spo2();
```

## src/bmi160.c
```c
#include <bmi160.h>

extern uint8_t pbuf[1024];
extern uint8_t *pos;
static struct device *bmi160;

/*
 * The values in the following map are the expected values that the
 * accelerometer needs to converge to if the device lies flat on the table. The
 * device has to stay still for about 500ms = 250ms(accel) + 250ms(gyro).
 */
struct sensor_value acc_calib[] = {
	{SENSOR_VALUE_TYPE_INT_PLUS_MICRO, { {0, 0} } },      /* X */
	{SENSOR_VALUE_TYPE_INT_PLUS_MICRO, { {0, 0} } },      /* Y */
	{SENSOR_VALUE_TYPE_INT_PLUS_MICRO, { {9, 806650} } }, /* Z */
};

static int auto_calibration(struct device* bmi160)
{
	/* calibrate accelerometer */
	if (sensor_attr_set(bmi160, SENSOR_CHAN_ACCEL_ANY,
			      SENSOR_ATTR_CALIB_TARGET, acc_calib) < 0) {
		return -EIO;
	}

	/*
	 * Calibrate gyro. No calibration value needs to be passed to BMI160 as
	 * the target on all axis is set internally to 0. This is used just to
	 * trigger a gyro calibration.
	 */
	if (sensor_attr_set(bmi160, SENSOR_CHAN_GYRO_ANY,
			      SENSOR_ATTR_CALIB_TARGET, NULL) < 0) {
		return -EIO;
	}

	return 0;
}


/**
 * @brief Helper function for printing a sensor value to a buffer
 *
 * @param buf A pointer to the buffer to which the printing is done.
 * @param len Size of buffer in bytes.
 * @param val A pointer to a sensor_value struct holding the value
 *            to be printed.
 *
 * @return The number of characters printed to the buffer.
 */
static inline int sensor_value_snprintf(char *buf, size_t len, const struct sensor_value *val)
{
	int32_t val1, val2;

	switch (val->type) {
	case SENSOR_VALUE_TYPE_INT:
		return snprintf(buf, len, "%d", val->val1);
	case SENSOR_VALUE_TYPE_INT_PLUS_MICRO:
		if (val->val2 == 0) {
			return snprintf(buf, len, "%d", val->val1);
		}

		/* normalize value */
		if (val->val1 < 0 && val->val2 > 0) {
			val1 = val->val1 + 1;
			val2 = val->val2 - 1000000;
		} else {
			val1 = val->val1;
			val2 = val->val2;
		}

		/* print value to buffer */
		if (val1 > 0 || (val1 == 0 && val2 > 0)) {
			return snprintf(buf, len, "%d.%06d", val1, val2);
		} else if (val1 == 0 && val2 < 0) {
			return snprintf(buf, len, "-0.%06d", -val2);
		} else {
			return snprintf(buf, len, "%d.%06d", val1, -val2);
		}
	case SENSOR_VALUE_TYPE_DOUBLE:
		return snprintf(buf, len, "%f", val->dval);
	default:
		return 0;
	}
}

void get_gyro_data(struct sensor_value* sensor_data_ps){
	if (sensor_channel_get(bmi160, SENSOR_CHAN_GYRO_ANY, sensor_data_ps) < 0) {
		printf("Cannot read bmi160 gyro channels.\n");
		return;
	}
}

void get_temp_data(struct sensor_value* sensor_data_ps){
	if (sensor_channel_get(bmi160, SENSOR_CHAN_TEMP, sensor_data_ps) < 0) {
		printf("Temperature channel read error.\n");
		return;
	}
}

void get_accel_data(struct sensor_value* sensor_data_ps){
	if (sensor_channel_get(bmi160, SENSOR_CHAN_ACCEL_ANY, sensor_data_ps) < 0) {
		printf("Cannot read bmi160 accel channels.\n");
		return;
	}
}

int sample_update () {
	return sensor_sample_fetch(bmi160);
}

void bmi160_sensor_init()
{
	printf("IMU: Binding...\n");
	bmi160 = device_get_binding("bmi160");
	if (!bmi160) {
		printf("Gyro: Device not found.\n");
		return;
	}

	/* auto calibrate accelerometer and gyro */
	if (auto_calibration(bmi160) < 0) {
		printf("HW calibration failed.\n");
		return;
	} else {
		printf("HW calibration passed.\n");
	}
}
```

## src/heartrate.c
```c
/* heartrate.c - source file for measuring heartrate */

/*
 * This implementation includes the source code from PulseSensor.com,
 * which is licensed under MIT license.
 * https://github.com/WorldFamousElectronics/PulseSensor_Amped_Arduino
 */

#include "heartrate.h"

uint32_t IBI = 600;			// value holds the time interval between beats! Must be seeded!
bool Pulse = false;     		// "True" when User's live heartbeat is detected. "False" when not a "live beat".
uint32_t rate[10];			// array to hold last ten IBI values
uint32_t lastBeatTime = 0;		// used to find IBI
uint32_t P = 2048;			// used to find peak in pulse wave, seeded
uint32_t T = 2048;			// used to find trough in pulse wave, seeded
uint32_t thresh = 2100;			// used to find instant moment of heart beat, seeded
uint32_t amp = 400;			// used to hold amplitude of pulse waveform, seeded
bool firstBeat = true;			// used to seed rate array so we startup with reasonable BPM
bool secondBeat = false;		// used to seed rate array so we startup with reasonable BPM

int measure_heartrate(uint32_t Signal)
{
	int HR = 0;
	int N = k_uptime_get_32() - lastBeatTime;	// monitor the time since the last beat to avoid noise

	// find the peak and trough of the pulse wave
	if(Signal < thresh && N > (IBI/5)*3) {	// avoid dichrotic noise by waiting 3/5 of last IBI
		if (Signal < T) {		// T is the trough
			T = Signal;		// keep track of lowest point in pulse wave
		}
	}

	if(Signal > thresh && Signal > P){	// thresh condition helps avoid noise
		P = Signal;			// P is the peak
	}					// keep track of highest point in pulse wave

	// NOW IT'S TIME TO LOOK FOR THE HEART BEAT
	// signal surges up in value every time there is a pulse
	if (N > 250 && N < 2000) {				// avoid noise. 30 bpm < possible human heart beat < 240
		if ( (Signal > thresh) && (Pulse == false) && (N > (IBI/5)*3) ){
			Pulse = true;				// set the Pulse flag when we think there is a pulse
			IBI = k_uptime_get_32() - lastBeatTime;	// measure time between beats in mS
			lastBeatTime = k_uptime_get_32();		// keep track of time for next pulse

			if(secondBeat) {			// if this is the second beat, if secondBeat == TRUE
				secondBeat = false;		// clear secondBeat flag
				for(int i=0; i<=9; i++) {	// seed the running total to get a realisitic BPM at startup
					rate[i] = IBI;
				}
			}

			if(firstBeat) {				// if it's the first time we found a beat, if firstBeat == TRUE
				firstBeat = false;		// clear firstBeat flag
				secondBeat = true;		// set the second beat flag
				return 0;			// IBI value is unreliable so discard it
			}


			// keep a running total of the last 10 IBI values
			int runningTotal = 0;			// clear the runningTotal variable

			for(int i=0; i<=8; i++) {		// shift data in the rate array
				rate[i] = rate[i+1];		// and drop the oldest IBI value
				runningTotal += rate[i];	// add up the 9 oldest IBI values
			}

			rate[9] = IBI;				// add the latest IBI to the rate array
			runningTotal += rate[9];		// add the latest IBI to runningTotal
			runningTotal /= 10;			// average the last 10 IBI values
			HR = 30000/runningTotal;		// how many beats can fit into a minute? that's BPM!
		}
	}

	if (Signal < thresh && Pulse == true) {	// when the values are going down, the beat is over
		Pulse = false;			// reset the Pulse flag so we can do it again
		amp = P - T;			// get amplitude of the pulse wave
		thresh = (amp * 2 / 3) + T;	// set thresh at 67% of the amplitude
		P = thresh;			// reset these for next time
		T = thresh;
	}

	if (N > 2500) {				// if 2.5 seconds go by without a beat
		thresh = 2048;			// set thresh default
		P = 2048;			// set P default
		T = 2048;			// set T default
		lastBeatTime = k_uptime_get_32();	// bring the lastBeatTime up to date
		firstBeat = true;		// set these to avoid noise
		secondBeat = false;		// when we get the heartbeat back
	}
	return HR;
}
```

## src/max30100.c
```c
// This source code has been adapted from a reference implementation originally fo the Arduino platform.
// The orriginal source code is available here: https://github.com/oxullo/Arduino-MAX30100
// The source code is covered unter the GPL licence, which can be found here:

// This file handles the raw data comms from the device.
#include <max30100.h>

int max30100_init(struct device *i2c_dev)
{
    printk("MAX30100: Location: 0x%x\n", i2c_dev);

    printk("MAX30100: Setting mode\n");
    max30100_set_mode(i2c_dev, DEFAULT_MODE);
    printk("MAX30100: Setting LED pulse width\n");
    max30100_set_leds_pulse_width(i2c_dev, DEFAULT_PULSE_WIDTH);
    printk("MAX30100: Setting sampling rate\n");
    max30100_set_sampling_rate(i2c_dev, DEFAULT_SAMPLING_RATE);
    printk("MAX30100: Setting LED current\n");
    max30100_set_leds_current(i2c_dev, DEFAULT_IR_LED_CURRENT, DEFAULT_RED_LED_CURRENT);
    printk("MAX30100: Setting High res mode\n");
    max30100_set_highres_mode_enabled(i2c_dev, true);

    uint8_t whoami = 0;
    int ret = i2c_reg_read_byte(i2c_dev, MAX30100_I2C_ADDRESS, MAX30100_REG_REVISION_ID, &whoami);

    printk("MAX30100: Revision: %d\n", whoami);

    return 0;
}

void max30100_set_mode(struct device *i2c_dev, uint8_t modeConfig)
{
    i2c_reg_write_byte(i2c_dev, MAX30100_I2C_ADDRESS, MAX30100_REG_MODE_CONFIGURATION, modeConfig);
}

void max30100_start_temperature(struct device *i2c_dev)
{
    // Set up the read register
    uint8_t modeConfig;
    i2c_reg_read_byte(i2c_dev, MAX30100_I2C_ADDRESS, MAX30100_REG_MODE_CONFIGURATION, &modeConfig);
    modeConfig |= MAX30100_MC_TEMP_EN;

    i2c_reg_write_byte(i2c_dev, MAX30100_I2C_ADDRESS, MAX30100_REG_MODE_CONFIGURATION, modeConfig);
}

bool max30100_is_temperature_ready(struct device *i2c_dev)
{
    uint8_t tempReady;
    i2c_reg_read_byte(i2c_dev, MAX30100_I2C_ADDRESS, MAX30100_REG_MODE_CONFIGURATION, &tempReady);

    return !(tempReady & MAX30100_MC_TEMP_EN);
}

uint8_t temp_stor[2];

float max30100_get_temperature(struct device *i2c_dev)
{
    i2c_burst_read(i2c_dev, MAX30100_I2C_ADDRESS, MAX30100_REG_TEMPERATURE_DATA_INT, temp_stor, 2);

    float temp = temp_stor[0];
    temp += temp_stor[1] * 0.0625f;

    return temp;
}

void max30100_set_leds_pulse_width(struct device *i2c_dev, uint8_t ledPulseWidth)
{
    uint8_t previous;
    i2c_reg_read_byte(i2c_dev, MAX30100_I2C_ADDRESS, MAX30100_REG_SPO2_CONFIGURATION, &previous);
    i2c_reg_write_byte(i2c_dev, MAX30100_I2C_ADDRESS, MAX30100_REG_SPO2_CONFIGURATION, (previous & 0xfc) | ledPulseWidth);
}

void max30100_set_sampling_rate(struct device *i2c_dev, uint8_t samplingRate)
{
    uint8_t previous;
    i2c_reg_read_byte(i2c_dev, MAX30100_I2C_ADDRESS, MAX30100_REG_SPO2_CONFIGURATION, &previous);
    i2c_reg_write_byte(i2c_dev, MAX30100_I2C_ADDRESS, MAX30100_REG_SPO2_CONFIGURATION, (previous & 0xe3) | (samplingRate << 2));
}

void max30100_set_leds_current(struct device *i2c_dev, uint8_t irLedCurrent, uint8_t redLedCurrent)
{
    i2c_reg_write_byte(i2c_dev, MAX30100_I2C_ADDRESS, MAX30100_REG_LED_CONFIGURATION, redLedCurrent << 4 | irLedCurrent);
}

void max30100_set_highres_mode_enabled(struct device *i2c_dev, bool enabled)
{
    uint8_t previous;
    i2c_reg_read_byte(i2c_dev, MAX30100_I2C_ADDRESS, MAX30100_REG_SPO2_CONFIGURATION, &previous);
    if (enabled)
    {
        i2c_reg_write_byte(i2c_dev, MAX30100_I2C_ADDRESS, MAX30100_REG_SPO2_CONFIGURATION, previous | MAX30100_SPC_SPO2_HI_RES_EN);
    }
    else
    {
        i2c_reg_write_byte(i2c_dev, MAX30100_I2C_ADDRESS, MAX30100_REG_SPO2_CONFIGURATION, previous & ~MAX30100_SPC_SPO2_HI_RES_EN);
    }
}

void max30100_update(struct device *i2c_dev, uint8_t *buffer)
{
    i2c_burst_read(i2c_dev, MAX30100_I2C_ADDRESS, MAX30100_REG_FIFO_DATA, buffer, 4);
}
```

## src/max30100_beat_detector.c
```c
#include <max30100_beat_detector.h>

BeatDetectorState max30100_beat_detector_state = BEATDETECTOR_STATE_INIT;
float threshold = BEATDETECTOR_MIN_THRESHOLD;
float beatPeriod = 0;
float lastMaxValue = 0;
uint64_t tsLastBeat = 0;

bool max30100_beat_detector_sample(float ir_sample_f32)
{
    bool beatDetected = false;
    switch (max30100_beat_detector_state)
    {
    case BEATDETECTOR_STATE_INIT:
        if (time > BEATDETECTOR_INIT_HOLDOFF)
        {
            max30100_beat_detector_state = BEATDETECTOR_STATE_WAITING;
        }
        break;

    case BEATDETECTOR_STATE_WAITING:
        if (ir_sample_f32 > threshold)
        {
            threshold = min(ir_sample_f32, BEATDETECTOR_MAX_THRESHOLD);
            max30100_beat_detector_state = BEATDETECTOR_STATE_FOLLOWING_SLOPE;
        }

        // Tracking lost, resetting
        if ((time - tsLastBeat) > BEATDETECTOR_INVALID_READOUT_DELAY)
        {
            beatPeriod = 0;
            lastMaxValue = 0;
        }

        max30100_beat_detector_decrease_threshold();
        break;

    case BEATDETECTOR_STATE_FOLLOWING_SLOPE:
        if (ir_sample_f32 < threshold)
        {
            max30100_beat_detector_state = BEATDETECTOR_STATE_MAYBE_DETECTED;
        }
        else
        {
            threshold = min(ir_sample_f32, BEATDETECTOR_MAX_THRESHOLD);
        }
        break;

    case BEATDETECTOR_STATE_MAYBE_DETECTED:
        if ((ir_sample_f32 + BEATDETECTOR_STEP_RESILIENCY) < threshold)
        {
            // Found a beat
            beatDetected = true;
            lastMaxValue = ir_sample_f32;
            max30100_beat_detector_state = BEATDETECTOR_STATE_MASKING;
            float delta = time - tsLastBeat;
            if (delta)
            {
                beatPeriod = BEATDETECTOR_BPFILTER_ALPHA * delta +
                             (1 - BEATDETECTOR_BPFILTER_ALPHA) * beatPeriod;
            }

            tsLastBeat = time;
        }
        else
        {
            max30100_beat_detector_state = BEATDETECTOR_STATE_FOLLOWING_SLOPE;
        }
        break;

    case BEATDETECTOR_STATE_MASKING:
        if ((time - tsLastBeat) > BEATDETECTOR_MASKING_HOLDOFF)
        {
            max30100_beat_detector_state = BEATDETECTOR_STATE_WAITING;
        }
        max30100_beat_detector_decrease_threshold();
        break;
    }

    return beatDetected;
}

float max30100_beat_detector_get_rate()
{
    if (beatPeriod != 0)
    {
        return 1.0f / beatPeriod * 1000 * 60;
    }
    else
    {
        return 0;
    }
}

void max30100_beat_detector_decrease_threshold()
{
    // When a valid beat rate readout is present, target the
    if (lastMaxValue > 0 && beatPeriod > 0)
    {
        threshold -= lastMaxValue * (1 - BEATDETECTOR_THRESHOLD_FALLOFF_TARGET) /
                     (beatPeriod / BEATDETECTOR_SAMPLES_PERIOD);
    }
    else
    {
        // Asymptotic decay
        threshold *= BEATDETECTOR_THRESHOLD_DECAY_FACTOR;
    }

    if (threshold < BEATDETECTOR_MIN_THRESHOLD)
    {
        threshold = BEATDETECTOR_MIN_THRESHOLD;
    }
}

void max30100_beat_detector_reset()
{
    beatPeriod = 0;
    lastMaxValue = 0;
    max30100_beat_detector_state = BEATDETECTOR_STATE_INIT;
}
```

## src/max30100_pulse_oximeter.c
```c
#include <max30100_pulse_oximeter.h>

#define DC_REMOVAL_VAL(x, w, alpha) (x + alpha * w)
#define DC_REMOVAL_PREV(x, w, alpha) (DC_REMOVAL_VAL(x, w, alpha) - w)

PulseOximeterState max30100_pulse_oximeter_state = PULSEOXIMETER_STATE_IDLE;
float led_ir_ac_dcw = 0;
float led_red_ac_dcw = 0;
uint8_t redLedPower;

uint32_t tsFirstBeatDetected;
uint32_t tsLastBeatDetected;
uint32_t tsLastSample;
uint32_t tsLastBiasCheck;
uint32_t tsLastCurrentAdjustment;
uint32_t tsLastTemperaturePoll;

float beat_detection_filter[2];

// http://sam-koblenski.blogspot.de/2015/11/everyday-dsp-for-programmers-dc-and.html
float _dc_removal(float x, float *w, float alpha)
{
    float w_n = x + alpha * (*w);
    float y = w_n - (*w);
    *w = w_n;
    return y;
}

// http://www.schwietering.com/jayduino/filtuino/
// Low pass butterworth filter order=1 alpha1=0.1
// Fs=100Hz, Fc=6Hz
float _low_pass_filter(float x, float *v)
{
    v[0] = v[1];
    v[1] = (2.452372752527856026e-1 * x) + (0.50952544949442879485 * v[0]);
    return (v[0] + v[1]);
}

void max30100_pulse_oximeter_init(struct device *i2c_dev)
{
    max30100_pulse_oximeter_heartrate = 0;

    max30100_set_mode(i2c_dev, MAX30100_MODE_SPO2_HR);
    max30100_set_leds_current(i2c_dev, IR_LED_CURRENT, RED_LED_CURRENT_START);

    beat_detection_filter[0] = 0;
    beat_detection_filter[1] = 0;

    max30100_pulse_oximeter_state = PULSEOXIMETER_STATE_IDLE;

    max30100_start_temperature(i2c_dev);

    printk("MAX30100: Waiting for the device to become ready\n");
    while (!max30100_is_temperature_ready(i2c_dev))
    {
        k_sleep(50);
    }
    printk("MAX30100: Ready!\n");
}

uint8_t buffer[4];
void max30100_pulse_oximeter_update(struct device *i2c_dev)
{
    if ((time - tsLastSample) > SAMPLE_TIME)
    {
        //printk("MAX30100: Updating data from FIFO - 0x%x\n", i2c_dev);
        max30100_update(i2c_dev, buffer);
        //printk("MAX30100: Received data from FIFO\n");

        // Warning: the values are always left-aligned
        uint16_t raw_ir_value = (buffer[0] << 8) | buffer[1];
        uint16_t raw_red_value = (buffer[2] << 8) | buffer[3];

        //printk("MAX30100: Filtering LED data\n");
        float led_ir_ac_value = _dc_removal(raw_ir_value, &led_ir_ac_dcw, DC_REMOVER_ALPHA);
        float led_red_ac_value = _dc_removal(raw_red_value, &led_red_ac_dcw, DC_REMOVER_ALPHA);

        //printk("MAX30100: Applying Low Pass filter for the heart beat class\n");
        float led_ir_heartrate_filtered_sample = _low_pass_filter(-led_ir_ac_value, beat_detection_filter);

        //printk("MAX30100: Sending sample to the heartbeat sample function\n");
        bool beat_detected = max30100_beat_detector_sample(led_ir_heartrate_filtered_sample);
        float hrs = max30100_beat_detector_get_rate();

        if (hrs > 0)
        {
            max30100_pulse_oximeter_state = PULSEOXIMETER_STATE_DETECTING;
            max30100_spo2_calculator_update(led_ir_ac_value, led_red_ac_value, beat_detected);

            if (beat_detected)
            {
                max30100_pulse_oximeter_spo2 = max30100_spo2_calculator_get_spo2();
                max30100_pulse_oximeter_heartrate = (uint8_t)hrs;
                max30100_pulse_oximeter_temperature = (int16_t)(max30100_get_temperature(i2c_dev) * 100);

           //     printk("MAX30100: Temperature: %d / 100 C\n", max30100_pulse_oximeter_temperature);
           //     printk("MAX30100: Heartrate: %d bpm\n", max30100_pulse_oximeter_heartrate);
           //     printk("MAX30100: SpO2: %d %%\n", max30100_pulse_oximeter_spo2);
            }
        }
        else if (max30100_pulse_oximeter_state == PULSEOXIMETER_STATE_DETECTING)
        {
            max30100_pulse_oximeter_state = PULSEOXIMETER_STATE_IDLE;
            max30100_spo2_calculator_reset();
        }

        tsLastSample = time;
    }
    // Check current bias

    // Follower that adjusts the red led current in order to have comparable DC baselines between
    // red and IR leds. The numbers are really magic: the less possible to avoid oscillations
    if ((time - tsLastBiasCheck) > (CURRENT_ADJUSTMENT_PERIOD_MS))
    {
        bool changed = false;
        if (led_ir_ac_dcw - led_red_ac_dcw > 70000 && redLedPower < MAX30100_LED_CURR_50MA)
        {
            ++redLedPower;
            changed = true;
        }
        else if (led_red_ac_dcw - led_ir_ac_dcw > 70000 && redLedPower > 0)
        {
            --redLedPower;
            changed = true;
        }

        if (changed)
        {
        //    printk("MAX30100: Adjusting Red LED current to %d\n", redLedPower);
            max30100_set_leds_current(i2c_dev, IR_LED_CURRENT, redLedPower);
            tsLastCurrentAdjustment = time;
        }

        tsLastBiasCheck = time;
    }

    if ((time - tsLastTemperaturePoll) > (TEMPERATURE_SAMPLING_PERIOD_MS))
    {
        max30100_start_temperature(i2c_dev);
        while(!max30100_is_temperature_ready(i2c_dev)){
            max30100_beat_detector_reset();
        }       

        tsLastTemperaturePoll = time;
    }
}
```

## src/max30100_spo2_calculator.c
```c
#include <max30100_spo2_calculator.h>

static const uint8_t spO2LUT[43] = {100, 100, 100, 100, 99, 99, 99, 99, 99, 99, 98, 98, 98, 98,
                                    98, 97, 97, 97, 97, 97, 97, 96, 96, 96, 96, 96, 96, 95, 95,
                                    95, 95, 95, 95, 94, 94, 94, 94, 94, 93, 93, 93, 93, 93};

double irACValueSqSum;
double redACValueSqSum;

double log_10 = 2.30258509299;
uint8_t beatsDetectedNum;
uint32_t samplesRecorded;
uint8_t spO2;

// Simple ln
double ln(double x)
{
    int i, j;
    double sum = 0.0f;
    double power;

    for (i = 1; i <= 7; i++)
    { 
        power = 1.0f;
        for (j = 0; j < i; j++)
        {
            power = power * ((x - 1.0f) / x); 
        }
        sum += (1.0f / i) * power; 
    }
    return sum;
}

// Simple log
double log(double x){
    return ln(x) / log_10;
}

void max30100_spo2_calculator_update(float led_ir_ac_value, float led_red_ac_value, bool beat_detected)
{
    irACValueSqSum += (led_ir_ac_value * led_ir_ac_value);
    redACValueSqSum += (led_red_ac_value * led_red_ac_value);
    ++samplesRecorded;

    if (beat_detected)
    {
        ++beatsDetectedNum;
        if (beatsDetectedNum == CALCULATE_EVERY_N_BEATS)
        {
            float acSqRatio = 100.0 * log(redACValueSqSum / samplesRecorded) / log(irACValueSqSum / samplesRecorded);
            uint8_t index = 0;

            if (acSqRatio > 66)
            {
                index = (uint8_t)acSqRatio - 66;
            }
            else if (acSqRatio > 50)
            {
                index = (uint8_t)acSqRatio - 50;
            }
            max30100_spo2_calculator_reset();

            spO2 = spO2LUT[index];
        }
    }
}

void max30100_spo2_calculator_reset()
{
    samplesRecorded = 0;
    redACValueSqSum = 0;
    irACValueSqSum = 0;
    beatsDetectedNum = 0;
    spO2 = 0;
}

uint8_t max30100_spo2_calculator_get_spo2()
{
    return spO2;
}
```
